## conf/distro/otto.conf
```bitbake
# base on poky
require conf/distro/poky.conf

DISTRO = "otto"
DISTRO_NAME = "OTTO Distro"
DISTRO_VERSION = "1.0"

MAINTAINER = "Steven Hang <github.com/adorbs>"

DISTRO_FEATURES_remove= "x11 wayland vulkan"

DISABLE_SPLASH = "1"
DISABLE_RPI_BOOT_LOGO = "1"
ENABLE_I2C = "1"
ENABLE_SPI_BUS = "1"
ENABLE_UART = "1"
RPI_EXTRA_CONFIG = "dtoverlay=r61505w,rotate=270\n\
					dtoverlay=fe-pi-audio\n\
					framebuffer_width=320\n\
					framebuffer_height=240\n\
					gpio=23=ip,pu\n\
					gpio=24=ip,pu\n\
					gpio=25=ip,pd\n\
					hdmi_force_hotplug=1\n\
					hdmi_group=2\n\
					hdmi_mode=87\n\
					hdmi_cvt=320 240 60 1 0 0 0\n\
"
```

## conf/layer.conf
```bitbake
# We have a conf and classes directory, append to BBPATH
BBPATH .= ":${LAYERDIR}"

# We have a recipes directory containing .bb and .bbappend files, add to BBFILES
BBFILES += "${LAYERDIR}/recipes*/*/*.bb \
            ${LAYERDIR}/recipes*/*/*.bbappend"

BBFILE_COLLECTIONS += "otto"
BBFILE_PATTERN_otto := "^${LAYERDIR}/"
BBFILE_PRIORITY_otto = "9"

LAYERSERIES_COMPAT_otto = "thud"
```

## conf/machine/include/otto-base.inc
```bitbake
# Base config for OTTO machines

DEFAULTTUNE ?= "cortexa7thf-neon-vfpv4"

require conf/machine/include/tune-cortexa7.inc
require conf/machine/include/rpi-base.inc

IMAGE_FSTYPES = "tar.bz2 ext3 wic"
WKS_FILE = "sdimage-otto.wks"

MACHINE_EXTRA_RRECOMMENDS += "\
    linux-firmware-rpidistro-bcm43430 \
    linux-firmware-rpidistro-bcm43455 \
    bluez-firmware-rpidistro-bcm43430a1-hcd \
    bluez-firmware-rpidistro-bcm4345c0-hcd \
"

# Getting rid of misc junk
RPI_KERNEL_DEVICETREE_OVERLAYS_remove = "\
    overlays/at86rf233.dtbo \
    overlays/lirc-rpi.dtbo \
    overlays/rpi-poe.dtbo \
    overlays/vc4-kms-v3d.dtbo \
"

RPI_KERNEL_DEVICETREE_OVERLAYS += "\
    overlays/fe-pi-audio.dtbo \
    overlays/r61505w.dtbo \
"

SPLASH = "psplash"

SDIMG_KERNELIMAGE ?= "kernel7.img"
UBOOT_MACHINE = "rpi_3_32b_config"
SERIAL_CONSOLES ?= "115200;ttyS0"
PREFERRED_PROVIDER_virtual/kernel = "linux-raspberrypi-rt"
PREFERRED_PROVIDER_virtual/egl = "userland"
PREFERRED_PROVIDER_virtual/libgles2 = "userland"
MACHINE_FEATURES_remove = "vc4graphics"
MACHINEOVERRIDES = "rpi:${MACHINE}"

# vim: ft=ini
```

## conf/machine/otto-beta-v0.0.0.conf
```bitbake
#@TYPE: Machine
#@NAME: prOTTO
#@DESCRIPTION: Machine configuration for OTTO beta v0.0.0 boards

require conf/machine/include/otto-base.inc

OPENOCD_SWCLK_PIN = "16"
OPENOCD_SWDIO_PIN = "5"
OPENOCD_SRST_PIN  = "4"
```

## conf/machine/otto-beta-v0.1.0.conf
```bitbake
#@TYPE: Machine
#@NAME: otto-beta-v0.1.0
#@DESCRIPTION: Machine configuration for OTTO beta v0.1.0 boards

require conf/machine/include/otto-base.inc

OPENOCD_SWCLK_PIN = "16"
OPENOCD_SWDIO_PIN = "5"
OPENOCD_SRST_PIN  = "4"
OPENOCD_MCU_TYPE  = "stm32f4x"

OTTO_BOARD = "beta-v0.1"

RPI_EXTRA_CONFIG = "\
dtoverlay=st7789v\n\
dtparam=rotate=90\n\
dtoverlay=rpi-proto\n\
dtoverlay=\n\
dtparam=i2c_arm=on,i2c_arm_baudrate=10000\n\
"

RPI_KERNEL_DEVICETREE_OVERLAYS += "\
overlays/st7789v.dtbo \
overlays/rpi-proto.dtbo \
"
```

## conf/machine/otto-proto-v1.conf
```bitbake
#@TYPE: Machine
#@NAME: prOTTO
#@DESCRIPTION: Machine configuration for the early OTTO prototype boards known as prOTTO

require conf/machine/include/otto-base.inc

OPENOCD_SWCLK_PIN = "25"
OPENOCD_SWDIO_PIN = "24"
OPENOCD_SRST_PIN  = "23"
```

## sources/base/conf/bblayers.conf
```bitbake
LCONF_VERSION = "6"

BBPATH = "${TOPDIR}"
BSPDIR := "${@os.path.abspath(os.path.dirname(d.getVar('FILE', True)) + '/../..')}"

BBFILES ?= ""
BBLAYERS = " \
  ${BSPDIR}/sources/poky/meta \
  ${BSPDIR}/sources/poky/meta-poky \
  \
  ${BSPDIR}/sources/meta-openembedded/meta-oe \
  ${BSPDIR}/sources/meta-openembedded/meta-multimedia \
  ${BSPDIR}/sources/meta-openembedded/meta-networking \
  ${BSPDIR}/sources/meta-openembedded/meta-python \
  \
  ${BSPDIR}/sources/meta-raspberrypi \
  ${BSPDIR}/sources/meta-otto \
  ${BSPDIR}/sources/meta-clang \
"
```

## sources/meta-otto/conf/distro/otto.conf
```bitbake
# Distribution definition for: otto
#
# Copyright (c) 2011, Intel Corporation.
# All rights reserved.
#
# This file is released under the MIT license as described in
# ../meta/COPYING.MIT.

require conf/distro/poky.conf
DISTRO = "otto"
DISTROOVERRIDES = "poky:otto"
TCLIBC = "musl"
# FIXME: consider adding a new "tiny" feature
#DISTRO_FEATURES_append = " tiny"

# Distro config is evaluated after the machine config, so we have to explicitly
# set the kernel provider to override a machine config.
PREFERRED_PROVIDER_virtual/kernel = "linux-raspberrypi-rt"
## PREFERRED_VERSION_linux-yocto-tiny ?= "5.0%"

# We can use packagegroup-core-boot, but in the future we may need a new packagegroup-core-tiny
#POKY_DEFAULT_EXTRA_RDEPENDS += "packagegroup-core-boot"
# Drop kernel-module-af-packet from RRECOMMENDS
POKY_DEFAULT_EXTRA_RRECOMMENDS = ""

# FIXME: what should we do with this?
TCLIBCAPPEND = ""

# Disable wide char support for ncurses as we don't include it in
# in the LIBC features below.
# Leave native enable to avoid build failures
ENABLE_WIDEC = "false"
ENABLE_WIDEC_class-native = "true"

# Drop native language support. This removes the
# eglibc->bash->gettext->libc-posix-clang-wchar dependency.
USE_NLS="no"

# Comment out any of the lines below to disable them in the build
# DISTRO_FEATURES options:
# alsa bluetooth ext2 pcmcia usbgadget usbhost wifi nfs zeroconf pci
DISTRO_FEATURES_TINY = "pci"
DISTRO_FEATURES_NET = "ipv4 ipv6"
DISTRO_FEATURES_USB = "usbhost"
#DISTRO_FEATURES_USBGADGET = "usbgadget"
DISTRO_FEATURES_WIFI = "wifi"

DISTRO_FEATURES = "${DISTRO_FEATURES_TINY} \
                   ${DISTRO_FEATURES_NET} \
                   ${DISTRO_FEATURES_USB} \
                   ${DISTRO_FEATURES_USBGADGET} \
                   ${DISTRO_FEATURES_WIFI} \
                  "

# Enable LFS - see bug YOCTO #5865
DISTRO_FEATURES_append_libc-uclibc = " largefile"
DISTRO_FEATURES_append_libc-musl = " largefile"

DISTRO_FEATURES_class-native = "${DISTRO_FEATURES_DEFAULT} ${POKY_DEFAULT_DISTRO_FEATURES}"
DISTRO_FEATURES_class-nativesdk = "${DISTRO_FEATURES_DEFAULT} ${POKY_DEFAULT_DISTRO_FEATURES}"

# enable mdev/busybox for init
INIT_MANAGER = "sysvinit"
# Should be done automatically - but make sure...
VIRTUAL-RUNTIME_dev_manager = "busybox-mdev"

# Some stuff pulls in udev by default
PACKAGECONFIG_alsa-utils = ""
PACKAGECONFIG_libusb1 = ""

# FIXME: Consider adding "modules" to MACHINE_FEATURES and using that in
# packagegroup-core-base to select modutils-initscripts or not.  Similar with "net" and
# netbase.

# By default we only support initramfs. We don't build live as that
# pulls in a lot of dependencies for the live image and the installer, like
# udev, grub, etc.  These pull in gettext, which fails to build with wide
# character support.
## IMAGE_FSTYPES = "cpio.gz"

## QB_DEFAULT_FSTYPE = "${IMAGE_FSTYPES}"

# Drop v86d from qemu dependency list (we support serial)
# Drop grub from meta-intel BSPs
# FIXME: A different mechanism is needed here. We could define -tiny
#        variants of all compatible machines, but that leads to a lot
#        more machine configs to maintain long term.
MACHINE_ESSENTIAL_EXTRA_RDEPENDS = ""

# The mtrace script included by eglibc is a perl script. This means the system
# will build perl in case this package is installed. Since we don't care about
# this script for the purposes of tiny, remove the dependency from here.
RDEPENDS_${PN}-mtrace_pn-eglibc = ""

PNBLACKLIST[build-appliance-image] = "not buildable with otto"
PNBLACKLIST[core-image-base] = "not buildable with otto"
PNBLACKLIST[core-image-clutter] = "not buildable with otto"
PNBLACKLIST[core-image-full-cmdline] = "not buildable with otto"
PNBLACKLIST[core-image-rt] = "not buildable with otto"
PNBLACKLIST[core-image-rt-sdk] = "not buildable with otto"
PNBLACKLIST[core-image-sato] = "not buildable with otto"
PNBLACKLIST[core-image-sato-dev] = "not buildable with otto"
PNBLACKLIST[core-image-sato-sdk] = "not buildable with otto"
PNBLACKLIST[core-image-x11] = "not buildable with otto"
PNBLACKLIST[core-image-weston] = "not buildable with otto"
PNBLACKLIST[busybox-syslog] = "not buildable with otto"

# Disable python usage in opkg-utils since it won't build with tiny config
PACKAGECONFIG_remove_pn-opkg-utils = "python"

HOSTTOOLS += "python2"

# PACKAGECONFIG_remove_pn-libxml2 = "python"
# PACKAGECONFIG_remove_pn-libxml2-native = "python"

# TODO: Remove python3 from target.
#PNBLACKLIST_otto-image[python3] = "Disabled on otto"

CMDLINE = "dwc_otg.lpm_enable=0 console=serial0,115200 root=/dev/mmcblk0p2 rootfstype=ext4 rootwait init=/init"
DISABLE_SPLASH = "1"
DISABLE_RPI_BOOT_LOGO = "1"
ENABLE_I2C = "1"
# Disable the SPI driver so the screen driver can take over
ENABLE_SPI_BUS = "0"
ENABLE_UART = "1"
RPI_EXTRA_CONFIG += "\
framebuffer_width=320\n\
framebuffer_height=240\n\
gpio=${OPENOCD_SRST_PIN}=ip,pu\n\
gpio=${OPENOCD_SWCLK_PIN}=ip,pu\n\
gpio=${OPENOCD_SWDIO_PIN}=ip,pd\n\
hdmi_force_hotplug=1\n\
hdmi_group=2\n\
hdmi_mode=87\n\
hdmi_cvt=320 240 60 1 0 0 0\n\
"
# TODO: Get these automatically? From git tags or something??
# Note: stick to semantic versioning
# These will be put in the /etc/sw-versions file, and also in the sw-description file.
# This way, the different images are versioned, and only installed in different 
# (for firmware and mcu - we always install the software).
FIRMWARE_VERSION = "0.1.0"
SOFTWARE_VERSION = "0.1.0"
MCU_VERSION = "0.1.0"
# This is put in /etc/hwrevision. 
HARDWARE_VERSION = "0.3.0"

# vim: ft=sh
```

## sources/meta-otto/conf/machine/include/otto-base.inc
```bitbake
# Base config for OTTO machines

DEFAULTTUNE ?= "cortexa7thf-neon-vfpv4"

IMAGE_FSTYPES = "wic ext4.gz"
WKS_FILE = "sdimage-otto.wks"
WIC_CREATE_EXTRA_ARGS = "--no-fstab-update"

require conf/machine/include/tune-cortexa7.inc
require conf/machine/include/rpi-base.inc

MACHINE_EXTRA_RRECOMMENDS += "\
    linux-firmware-rpidistro-bcm43430 \
    linux-firmware-rpidistro-bcm43455 \
    bluez-firmware-rpidistro-bcm43430a1-hcd \
    bluez-firmware-rpidistro-bcm4345c0-hcd \
"

# Getting rid of misc junk
RPI_KERNEL_DEVICETREE_OVERLAYS_remove = "\
    overlays/at86rf233.dtbo \
    overlays/lirc-rpi.dtbo \
    overlays/rpi-poe.dtbo \
    overlays/vc4-kms-v3d.dtbo \
"

KERNEL_IMAGEDEST = "boot"
RDEPENDS_${KERNEL_PACKAGE_NAME}-base = "${KERNEL_PACKAGE_NAME}-image"
IMAGE_BOOT_FILES ?= "${BOOTFILES_DIR_NAME}/* \
                 ${@make_dtb_boot_files(d)} \
                 u-boot.bin;${SDIMG_KERNELIMAGE} boot.scr \
                 "


RPI_KERNEL_DEVICETREE_OVERLAYS = ""

SPLASH = "psplash"

SDIMG_KERNELIMAGE ?= "kernel7.img"
UBOOT_MACHINE = "rpi_3_32b_config"

# Disable gettys on tty1 and serial consoles
# Login shells are started from otto-image.inc
SERIAL_CONSOLES = ""
USE_VT = ""
SYSVINIT_ENABLED_GETTYS = ""

PREFERRED_PROVIDER_virtual/kernel = "linux-raspberrypi"
PREFERRED_PROVIDER_virtual/egl = "userland"
PREFERRED_PROVIDER_virtual/libgles2 = "userland"
MACHINE_FEATURES_remove = "vc4graphics"
MACHINEOVERRIDES = "rpi:${MACHINE}"

# We use U-boot to load the kernel, since this lets us use SWUpdate
RPI_USE_U_BOOT = "1"

# vim: ft=ini
```

## sources/meta-otto/conf/machine/otto-beta-v0.0.0.conf
```bitbake
#@TYPE: Machine
#@NAME: otto-beta-v0.0.0
#@DESCRIPTION: Machine configuration for OTTO beta v0.0.0 boards

require conf/machine/include/otto-base.inc

OPENOCD_SWCLK_PIN = "16"
OPENOCD_SWDIO_PIN = "5"
OPENOCD_SRST_PIN  = "4"
OPENOCD_MCU_TYPE  = "stm32f4x"

HWREVISION = "0.0.0"

RPI_EXTRA_CONFIG = "\
dtoverlay=st7789v\n\
dtoverlay=rpi-proto\n\
dtparam=i2c_arm=on,i2c_arm_baudrate=1000\n\
"

RPI_KERNEL_DEVICETREE_OVERLAYS += "\
overlays/st7789v.dtbo \
overlays/rpi-proto.dtbo \
"
```

## sources/meta-otto/conf/machine/otto-beta-v0.3.0.conf
```bitbake
#@TYPE: Machine
#@NAME: otto-beta-v0.3.0
#@DESCRIPTION: Machine configuration for OTTO beta v0.3.0 boards

require conf/machine/include/otto-base.inc

OPENOCD_SWCLK_PIN = "16"
OPENOCD_SWDIO_PIN = "5"
OPENOCD_SRST_PIN  = "4"
OPENOCD_MCU_TYPE  = "stm32f1x"

# Used in otto-core to choose the correct board.
# TODO: Either make correct version board or just make a single beta board
OTTO_BOARD = "beta-v0.1"
# Used in /etc/hwrevision, and for SWUpdate.
HWREVISION = "0.3.0"

RPI_EXTRA_CONFIG = "\
dtoverlay=rpi-proto\n\
dtoverlay=\n\
dtparam=i2c_arm=on,i2c_arm_baudrate=100000\n\
"

RPI_KERNEL_DEVICETREE_OVERLAYS += "\
overlays/rpi-proto.dtbo \
"
```

## sources/meta-otto/conf/machine/otto-proto-v1.conf
```bitbake
#@TYPE: Machine
#@NAME: otto-proto-v1
#@DESCRIPTION: Machine configuration for the early OTTO prototype boards known as prOTTO

require conf/machine/include/otto-base.inc

OPENOCD_SWCLK_PIN = "25"
OPENOCD_SWDIO_PIN = "24"
OPENOCD_SRST_PIN  = "23"
OPENOCD_MCU_TYPE  = "stm32f1x"

RPI_EXTRA_CONFIG = "\
dtoverlay=r51505\n\
dtoverlay=fe-pi-audio\n\
"

RPI_KERNEL_DEVICETREE_OVERLAYS += "\
overlays/r61505w.dtbo \
overlays/fe-pi-audio.dtbo \
"
```

## sources/meta-otto/wic/sdimage-otto.wks
```
# short-description: Create Raspberry Pi SD card image
# long-description: Creates a partitioned SD card image for use with
# Raspberry Pi.

# Boot files are located in the first vfat partition. The bootimg-partition source
# takes creates a partition from all files in the IMAGE_BOOT_FILES variable.
part /boot --source bootimg-partition --ondisk mmcblk0 --fstype=vfat --label boot --active --align 4096 --size 60

# Two copies of the rootfs. All files under /data are excluded, since these will be
# in the last data partition and mounted at that location.
part / --source rootfs --exclude-path=data/ --ondisk mmcblk0 --fstype=ext4 --label root --align 4096
part --source rootfs --exclude-path=data/ --ondisk mmcblk0 --fstype=ext4 --label root2 --align 4096

# The data partition
part /data --source rootfs --rootfs-dir=${IMAGE_ROOTFS}/data --ondisk mmcblk0 --fstype=ext4 --label data --align 4096 --size 1000
```
